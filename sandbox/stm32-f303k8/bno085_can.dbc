VERSION ""

NS_ :

BS_:

BU_: STM32 PC

BO_ 256 BNO085_GyroZ: 8 STM32
 SG_ Gyro_Z : 0|32@1- (1,0) [-3.4e+38|3.4e+38] "rad/s" PC
 SG_ Timestamp : 32|32@1- (1,0) [0|4.294967295e+09] "us" PC

SIG_VALTYPE_ 256 Gyro_Z : 2;

CM_ BO_ 256 "BNO085 gyroscope Z angular velocity and sensor timestamp";
CM_ SG_ 256 Gyro_Z "Z軸角速度 (SH2_GYROSCOPE_CALIBRATED.z, IEEE754 float, rad/s)";
CM_ SG_ 256 Timestamp "BNO085センサイベントのタイムスタンプ (uint32, マイクロ秒, 約71.6分で一周)";

BA_DEF_ BO_ "GenMsgCycleTime" INT 0 65535;
BA_DEF_DEF_ "GenMsgCycleTime" 0;
BA_ "GenMsgCycleTime" BO_ 256 10;
