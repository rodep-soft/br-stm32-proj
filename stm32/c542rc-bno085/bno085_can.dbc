VERSION ""

NS_ :

BS_:

BU_: STM32 PC

BO_ 1280 BNO085_Data: 20 STM32
 SG_ Timestamp_Ms : 0|32@1+ (1,0) [0|4294967295] "ms" PC
 SG_ Seq : 32|8@1+ (1,0) [0|255] "" PC
 SG_ Status : 40|8@1+ (1,0) [0|255] "" PC
 SG_ Accel_X : 48|16@1- (0.001,0) [-32.768|32.767] "m/s^2" PC
 SG_ Accel_Y : 64|16@1- (0.001,0) [-32.768|32.767] "m/s^2" PC
 SG_ Accel_Z : 80|16@1- (0.001,0) [-32.768|32.767] "m/s^2" PC
 SG_ Gyro_X : 96|16@1- (0.001,0) [-32.768|32.767] "rad/s" PC
 SG_ Gyro_Y : 112|16@1- (0.001,0) [-32.768|32.767] "rad/s" PC
 SG_ Gyro_Z : 128|16@1- (0.001,0) [-32.768|32.767] "rad/s" PC

CM_ BO_ 1280 "BNO085 CAN-FD 18-byte IMU payload (timestamp, sequence, status, 3-axis accelerometer and gyroscope; 20-byte DLC)";
CM_ SG_ 1280 Timestamp_Ms "起動からのミリ秒タイムスタンプ (uint32, ms)";
CM_ SG_ 1280 Seq "フレームのシーケンス番号 (uint8)";
CM_ SG_ 1280 Status "ファームウェアステータス (0=INIT, 1=OK, 2=WARN, 3=ERROR)";
CM_ SG_ 1280 Accel_X "X軸加速度 (int16, 0.001 m/s^2)";
CM_ SG_ 1280 Accel_Y "Y軸加速度 (int16, 0.001 m/s^2)";
CM_ SG_ 1280 Accel_Z "Z軸加速度 (int16, 0.001 m/s^2)";
CM_ SG_ 1280 Gyro_X "X軸角速度 (int16, 0.001 rad/s)";
CM_ SG_ 1280 Gyro_Y "Y軸角速度 (int16, 0.001 rad/s)";
CM_ SG_ 1280 Gyro_Z "Z軸角速度 (int16, 0.001 rad/s)";

BA_DEF_ BO_ "GenMsgCycleTime" INT 0 65535;
BA_DEF_DEF_ "GenMsgCycleTime" 0;
BA_ "GenMsgCycleTime" BO_ 1280 5;
